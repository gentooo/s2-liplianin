## linux/drivers/media/dvb/mantis/Kconfig
```kconfig
config DVB_MANTIS
	tristate "MANTIS based cards"
	depends on DVB_CORE && PCI && I2C && INPUT
	select DVB_MB86A16 if !DVB_FE_CUSTOMISE
	select DVB_CU1216 if !DVB_FE_CUSTOMISE
	select DVB_ZL10353 if !DVB_FE_CUSTOMISE
	select DVB_STV0299 if !DVB_FE_CUSTOMISE
	select DVB_PLL if !DVB_FE_CUSTOMISE
	help
	  Support for PCI cards based on the Mantis PCI bridge.
	  Say Y when you have a Mantis based DVB card and want to use it.

	  If unsure say N.
```

## linux/drivers/media/dvb/smi2032/Kconfig
```kconfig
config DVB_SMI2032
	tristate "Somagic SMI2032 support"
	depends on DVB_CORE && PCI && I2C
	select DVB_DS3000 if !DVB_FE_CUSTOMISE
	---help---
	  Support for cards based on Somagic SMI2032 PCI-e chip like
	  DVBWorld PCI-e 2006.

	  Since these cards have no MPEG decoder onboard, they transmit
	  only compressed MPEG data over the PCI bus, so you need
	  an external software decoder to watch TV on your computer.

	  To compile this driver as a module, choose M here: the
	  module will be called smi2032
```
